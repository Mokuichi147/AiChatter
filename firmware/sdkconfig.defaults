## firmware/sdkconfig.defaults
```kconfig
# CPU周波数
CONFIG_ESP_DEFAULT_CPU_FREQ_MHZ_240=y

# フラッシュサイズ (M5StickS3 = 8MB)
CONFIG_ESPTOOLPY_FLASHSIZE_8MB=y
CONFIG_ESPTOOLPY_FLASHSIZE="8MB"

# PSRAM (ESP-SR AFEに必須)
CONFIG_SPIRAM=y
CONFIG_SPIRAM_USE_MALLOC=y
CONFIG_SPIRAM_MODE_OCT=y
CONFIG_SPIRAM_SPEED_80M=y
CONFIG_SPIRAM_MALLOC_ALWAYSINTERNAL=16384

# I2S割り込み IRAM配置
CONFIG_I2S_ISR_IRAM_SAFE=y

# FreeRTOS ティック周期
CONFIG_FREERTOS_HZ=1000

# パーティションテーブル
CONFIG_PARTITION_TABLE_CUSTOM=y
CONFIG_PARTITION_TABLE_CUSTOM_FILENAME="partitions.csv"

# WiFi
CONFIG_ESP_WIFI_STATIC_RX_BUFFER_NUM=10
CONFIG_ESP_WIFI_DYNAMIC_RX_BUFFER_NUM=32
CONFIG_ESP_WIFI_DYNAMIC_TX_BUFFER=y

# WebSocketバッファ
CONFIG_WS_BUFFER_SIZE=65536

# ログレベル
CONFIG_LOG_DEFAULT_LEVEL_INFO=y

# タスクスタックサイズ
CONFIG_ESP_MAIN_TASK_STACK_SIZE=8192

# コンポーネント
CONFIG_ESP_SYSTEM_ALLOW_RTC_FAST_MEM_AS_HEAP=y
```
